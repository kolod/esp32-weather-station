## sdkconfig.defaults
```kconfig
# Target
CONFIG_IDF_TARGET="esp32"

# Flash
CONFIG_ESPTOOLPY_FLASHSIZE_16MB=y
CONFIG_ESPTOOLPY_FLASHSIZE="16MB"
CONFIG_ESPTOOLPY_FLASHMODE_QIO=y
CONFIG_ESPTOOLPY_FLASHFREQ_80M=y

# Partition table
CONFIG_PARTITION_TABLE_CUSTOM=y
CONFIG_PARTITION_TABLE_CUSTOM_FILENAME="partitions.csv"

# Bootloader OTA rollback
CONFIG_BOOTLOADER_APP_ROLLBACK_ENABLE=y

# LittleFS
CONFIG_LITTLEFS_MAX_PARTITIONS=1
CONFIG_LITTLEFS_PAGE_SIZE=256
CONFIG_LITTLEFS_OBJ_NAME_LEN=64
CONFIG_LITTLEFS_READ_SIZE=128
CONFIG_LITTLEFS_WRITE_SIZE=128

# LVGL (via esp_lvgl_port)
CONFIG_LV_USE_LOG=n
CONFIG_LV_FONT_MONTSERRAT_20=y
CONFIG_LV_FONT_MONTSERRAT_36=y
CONFIG_LV_FONT_MONTSERRAT_48=y

# TLS / HTTPS server
CONFIG_ESP_TLS_SERVER=y
CONFIG_ESP_HTTPS_SERVER_ENABLE=y
CONFIG_MBEDTLS_CERTIFICATE_BUNDLE=y
CONFIG_MBEDTLS_CERTIFICATE_BUNDLE_DEFAULT_CMN=y

# HTTP server request buffer large enough for OTA POST Content-Length header
CONFIG_HTTPD_MAX_REQ_HDR_LEN=1024
CONFIG_HTTPD_WS_SUPPORT=n

# WiFi
CONFIG_ESP_WIFI_STATIC_RX_BUFFER_NUM=10
CONFIG_ESP_WIFI_DYNAMIC_TX_BUFFER_NUM=32

# SNTP
CONFIG_LWIP_SNTP_MAX_SERVERS=2

# Heap — no PSRAM; keep IRAM usage reasonable
CONFIG_ESP32_DEFAULT_CPU_FREQ_240=y

# Stack sizes (components set their own via task creation)
CONFIG_ESP_MAIN_TASK_STACK_SIZE=4096

# Logging
CONFIG_LOG_DEFAULT_LEVEL_INFO=y
```
